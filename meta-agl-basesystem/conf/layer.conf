## meta-agl-basesystem/conf/layer.conf
```bitbake
# We have a conf and classes directory, add to BBPATH
BBPATH .= ":${LAYERDIR}"

# We have recipes-* directories, add to BBFILES
BBFILES += "${LAYERDIR}/recipes-*/*/*.bb \
        ${LAYERDIR}/recipes-*/*/*.bbclass \
	${LAYERDIR}/recipes-*/*/*.bbappend"

BBFILE_COLLECTIONS += "agl-basesystem"
BBFILE_PATTERN_agl-basesystem = "^${LAYERDIR}/"
BBFILE_PRIORITY_agl-basesystem = "70"

# for agl-basefiles recipe
HOSTTOOLS += " xpath "

LAYERSERIES_COMPAT_agl-basesystem = "thud"
```
